## Kconfig
```kconfig
menu "ESP-IDF KWS Engine Configuration"

    config ESP_KWS_DEFAULT_WAKE_THRESHOLD
        int "Default Wake Word Detection Threshold (percentage 10-99)"
        range 10 99
        default 80
        help
            Confidence percentage required to trigger wake word detection (default 80%).

    config ESP_KWS_DEFAULT_CMD_THRESHOLD
        int "Default Command Detection Threshold (percentage 10-99)"
        range 10 99
        default 75
        help
            Confidence percentage required to trigger command word detection (default 75%).

    config ESP_KWS_COMMAND_TIMEOUT_MS
        int "Command Listening Timeout in Milliseconds"
        range 1000 10000
        default 3500
        help
            Duration after wake detection to wait for an incoming command phrase before resetting to idle.

    config ESP_KWS_NUM_MEL_BINS
        int "Audio Frontend Mel Filterbank Channels"
        default 40
        help
            Number of log-mel filterbank bins extracted per audio frame.

endmenu
```

## examples/ws-esp32-p4-wifi6-kws-console-dev/sdkconfig.defaults
```kconfig
# ============================================================================
# Waveshare ESP32-P4-WIFI6 (Rev 1.3) Hardware Target Configuration
# ============================================================================
CONFIG_IDF_TARGET="esp32p4"
CONFIG_ESP32P4_SELECTS_REV_LESS_V3=y

# ============================================================================
# Flash Configuration (32 MB QIO Mode)
# ============================================================================
CONFIG_ESPTOOLPY_FLASHMODE_QIO=y
CONFIG_ESPTOOLPY_FLASHSIZE_32MB=y
CONFIG_ESPTOOLPY_FLASHFREQ_80M=y

# ============================================================================
# PSRAM Configuration (32 MB HEX-Line @ 200 MHz)
# ============================================================================
CONFIG_SPIRAM=y
CONFIG_SPIRAM_MODE_HEX=y
CONFIG_SPIRAM_SPEED_200M=y
CONFIG_SPIRAM_USE_MALLOC=y
CONFIG_SPIRAM_MALLOC_ALWAYSINTERNAL=16384
CONFIG_SPIRAM_MALLOC_RESERVE_INTERNAL=32768

# ============================================================================
# Compiler Optimization (CRITICAL for Streaming Neural Inference)
# ============================================================================
CONFIG_COMPILER_OPTIMIZATION_PERF=y
CONFIG_COMPILER_OPTIMIZATION_ASSERTIONS_DISABLE=y
CONFIG_ESP_TASK_WDT_TIMEOUT_S=10

# ============================================================================
# FreeRTOS Configuration
# ============================================================================
CONFIG_FREERTOS_HZ=1000
CONFIG_FREERTOS_TASK_CREATE_ALLOW_EXT_MEM=n

# ============================================================================
# Power Management
# ============================================================================
CONFIG_PM_ENABLE=y

# ============================================================================
# Log Output Configuration
# ============================================================================
CONFIG_LOG_DEFAULT_LEVEL_INFO=y
CONFIG_LOG_COLORS=y
CONFIG_LOG_TIMESTAMP_SOURCE_RTOS=y
```
